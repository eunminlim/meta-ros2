## conf/layer.conf
```bitbake
# We have a conf and classes directory, append to BBPATH
BBPATH .= ":${LAYERDIR}"

# We have a recipes directory, add to BBFILES
BBFILES += "${LAYERDIR}/recipes-*/*/*.bb ${LAYERDIR}/recipes-*/*/*.bbappend"

BBFILE_COLLECTIONS += "ros-layer"
BBFILE_PATTERN_ros-layer := "^${LAYERDIR}/"
BBFILE_PRIORITY_ros-layer = "7"

LICENSE_PATH += "${LAYERDIR}/licenses"

ROSDISTRO := "indigo"
PNBLACKLIST[poco] = ""
PNBLACKLIST[asio] = ""
PNBLACKLIST[opencv] = ""
PNBLACKLIST[libsdl-image] = ""

# The default repo name is the "base" component name (no -native, etc.)
WEBOS_REPO_NAME ??= "${BPN}"

WEBOS_GIT_PARAM_BRANCH ?= "master"
WEBOS_GIT_BRANCH ?= ";branch=${WEBOS_GIT_PARAM_BRANCH}"
# Default is empty but webos_enhanced_submissions.bbclass will always set the value
WEBOS_GIT_PARAM_TAG ?= ""
WEBOS_GIT_TAG ?= ";tag=${WEBOS_GIT_PARAM_TAG}"
WEBOS_TCMONIKER ?= "tc4"

# All the webOS Pro repos will be private
WEBOS_PRO_GIT_REPO_SERVER ?= "gpro.lgsvl.com"
WEBOS_PRO_GIT_REPO_PREFIX ?= "git://${WEBOS_PRO_GIT_REPO_SERVER}/webos-pro"
WEBOS_PRO_GIT_REPO_COMPLETE ?= "${WEBOS_PRO_GIT_REPO_PREFIX}/${WEBOS_REPO_NAME}${WEBOS_GIT_TAG}${WEBOS_GIT_BRANCH};protocol=ssh"

WEBOS_PRO_EXPERIMENTAL_GIT_REPO_PREFIX ?= "git://${WEBOS_PRO_GIT_REPO_SERVER}/z-experimental/webos-pro"
WEBOS_PRO_EXPERIMENTAL_GIT_REPO_COMPLETE ?= "${WEBOS_PRO_EXPERIMENTAL_GIT_REPO_PREFIX}/${WEBOS_REPO_NAME}${WEBOS_GIT_TAG}${WEBOS_GIT_BRANCH};protocol=ssh"

# For components which will be released to public github later, but now are only on gpro
OPENWEBOS_PRIVATE_GIT_REPO_SERVER ?= "gpro.lgsvl.com/webos"
OPENWEBOS_PRIVATE_GIT_REPO_PREFIX ?= "git://${OPENWEBOS_PRIVATE_GIT_REPO_SERVER}"
OPENWEBOS_PRIVATE_GIT_REPO_COMPLETE ?= "${OPENWEBOS_PRIVATE_GIT_REPO_PREFIX}/${WEBOS_REPO_NAME}${WEBOS_GIT_TAG}${WEBOS_GIT_BRANCH};protocol=ssh"

# The location of the repos for the LG kernels and toolchains
WEBOS_PRO_KERNEL_GIT_REPO_SERVER ?= "kernel.lge.com"
WEBOS_PRO_KERNEL_GIT_REPO_PREFIX ?= "git://${WEBOS_PRO_KERNEL_GIT_REPO_SERVER}"
WEBOS_PRO_KERNEL_GIT_REPO_COMPLETE ?= "${WEBOS_PRO_KERNEL_GIT_REPO_PREFIX}/${WEBOS_REPO_NAME}${WEBOS_GIT_TAG}${WEBOS_GIT_BRANCH};protocol=ssh"

# The location of the pre-built binaries
WEBOS_PRO_BIN_SERVER ?= "webos.lge.com"
WEBOS_PRO_BIN_SERVER_PREFIX ?= "http://${WEBOS_PRO_BIN_SERVER}/binary/webos-pro"
# The choices for WEBOS_PRO_BIN_SERVER_TARGET are:
#   "all", the first value from WEBOS_PREBUILT_BINARIES_FOR, "arm", "i586", "native".
WEBOS_PRO_BIN_SERVER_TARGET ?= "${@oe.utils.conditional('PACKAGE_ARCH', 'all', 'all', (d.getVar('WEBOS_PREBUILT_BINARIES_FOR', True) or '${TRANSLATED_TARGET_ARCH}').split()[0], d)}"
WEBOS_PRO_BIN_SERVER_TARGET_class-native ?= "native"
WEBOS_PRO_BIN_SERVER_TARGET_class-nativesdk ?= "native"
WEBOS_PRO_BIN_SERVER_COMPLETE ?= "${WEBOS_PRO_BIN_SERVER_PREFIX}/${WEBOS_PRO_BIN_SERVER_TARGET}/official/${WEBOS_REPO_NAME}/${WEBOS_REPO_NAME}-${WEBOS_PRO_BIN_SERVER_TARGET}-${PV}.tar.bz2"

# The location of the pre-built binaries from LGSVL
WEBOS_PRO_LGSVL_BIN_SERVER ?= "binary.lgsvl.com"
WEBOS_PRO_LGSVL_BIN_SERVER_BUILD_CODENAME ?= "webos-pro"
WEBOS_PRO_LGSVL_BIN_SERVER_PREFIX ?= "https://${WEBOS_PRO_LGSVL_BIN_SERVER}/${WEBOS_PRO_LGSVL_BIN_SERVER_BUILD_CODENAME}"
WEBOS_PRO_LGSVL_BIN_SERVER_TOOLCHAIN_SUFFIX ?= "-${WEBOS_TCMONIKER}${@bb.utils.contains('TUNE_FEATURES', 'callconvention-hard', 'hf', '', d)}"
# The choices for WEBOS_PRO_LGSVL_BIN_SERVER_TARGET are:
#   "all", the first value from WEBOS_PREBUILT_BINARIES_FOR, "arm", "i586", "native".
# Note that there can't be MACHINE-specific native tool binaries; native tools
# must work for all MACHINE-s.
WEBOS_PRO_LGSVL_BIN_SERVER_TARGET ?= "${@oe.utils.conditional('PACKAGE_ARCH', 'all', 'all', (d.getVar('WEBOS_PREBUILT_BINARIES_FOR', True) or '${TRANSLATED_TARGET_ARCH}').split()[0], d)}"
WEBOS_PRO_LGSVL_BIN_SERVER_TARGET_class-native ?= "native"
WEBOS_PRO_LGSVL_BIN_SERVER_TARGET_class-nativesdk ?= "native"
WEBOS_PRO_LGSVL_BIN_SERVER_COMPLETE ?= "${WEBOS_PRO_LGSVL_BIN_SERVER_PREFIX}/${WEBOS_PRO_LGSVL_BIN_SERVER_TARGET}/official/${WEBOS_REPO_NAME}/${WEBOS_REPO_NAME}-${WEBOS_PRO_LGSVL_BIN_SERVER_TARGET}${WEBOS_PRO_LGSVL_BIN_SERVER_TOOLCHAIN_SUFFIX}-${PV}.tar.bz2"

# Temporarily until these components:
# omx-components, omxplayer, settingsservice-conf, avoutput-adaptation-layer-rpi
# are moved to public repository or webos-pro (for omxplayer)
APOLLO_GIT_REPO_SERVER ?= "gpro.lgsvl.com"
APOLLO_GIT_REPO_PREFIX ?= "git://${APOLLO_GIT_REPO_SERVER}/apollo"
APOLLO_GIT_REPO_COMPLETE ?= "${APOLLO_GIT_REPO_PREFIX}/${WEBOS_REPO_NAME}${WEBOS_GIT_TAG}${WEBOS_GIT_BRANCH};protocol=ssh"
```
